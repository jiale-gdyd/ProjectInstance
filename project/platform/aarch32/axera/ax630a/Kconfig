## project/platform/aarch32/axera/ax630a/Kconfig
```kconfig
#
# AXera ax630a Application Kconfig
# 

menu "AXera ax630a Application"


endmenu
```

## project/platform/aarch32/nxp/Kconfig
```kconfig
#
# NXP AArch32 Platform Application Kconfig
# 

menu "NXP AArch32 Platform Application"



endmenu
```

## project/platform/aarch32/rockchip/Kconfig
```kconfig
#
# Rockchip AArch32 Platform Application Kconfig
# 

menu "Rockchip AArch32 Platform Application"

source "project/platform/aarch32/rockchip/rknpu/Kconfig"
source "project/platform/aarch32/rockchip/rv11xx/Kconfig"

endmenu
```

## project/platform/aarch32/rockchip/rknpu/Kconfig
```kconfig
#
# Rockchip NPU Kconfig
# 

menu "Rockchip NPU"

choice

prompt "Rockchip NPU Architecture"
depends on ROCKCHIP
default RKNPU1

config RKNPU1
    bool "Rockchip first generation NPU architecture"

config RKNPU2
    bool "Rockchip second generation NPU architecture"

endchoice

endmenu
```

## project/platform/aarch32/rockchip/rv11xx/Kconfig
```kconfig
#
# Rockchip rv11xx(rv1109/rv1126) Application Kconfig
# 

menu "Rockchip rv1109/rv1126 Application"

choice
prompt "Rockchip rv1109/rv1126 Application Implementation"
depends on ROCKCHIP && RV11XX
default RV11XX_EMS

config RV11XX_EMS
    bool "Electronic rearview mirror system"
    depends on MEDIA_API
    depends on RKRGA
    depends on RKMPP
    depends on LIBDRM

config RV11XX_UNKNOWN
    bool "Unknown Application"
endchoice

endmenu
```

## project/platform/aarch64/Kconfig
```kconfig
#
# aarch64 Kconfig
#

menu "AArch64 platform"

source "project/platform/aarch64/nvidia/Kconfig"

endmenu
```

## project/platform/aarch64/nvidia/Kconfig
```kconfig
#
# Nvidia AArch64 Platform Application Kconfig
# 

menu "Nvidia AArch64 Platform Application"

source "project/platform/aarch64/nvidia/jetson/Kconfig"

endmenu
```

## project/platform/aarch64/nvidia/jetson/Kconfig
```kconfig
#
# Nvidia jetson(nano/nx) Application Kconfig
# 

menu "Nvidia jetson Application"

choice
prompt "Nvidia jetson Application Implementation"
depends on NVIDIA && JETSON
default JETSON_UNKNOWN

config JETSON_XAVIER_DSL
    bool "Nvidia Jetson Xavier NX deepstream-services-library"

config JETSON_UNKNOWN
    bool "Unknown Application"
endchoice

endmenu
```

## project/platform/vendor/Kconfig
```kconfig
#
# Board Kconfig
#

menu "Platform Vendor Board"

menu "AXera Platform Board"
config AXERA
    bool "AXera"
    default n
    help
      https://www.axera-tech.com

choice
    prompt "AXera soc choice"
    depends on AXERA
    default AX620A

    config AX620A
        bool "Quad Core Cortex-A7"
        select AARCH32
        select CORTEX_A7

    config AX630A
        bool "Quad Core Cortex-A53"
        select AARCH32
        select CORTEX_A53
endchoice
endmenu

menu "NXP Semiconductors Platform Board"
config NXP
    bool "freescale"
    default n
    help
      Nxp Semiconductors N.V.

choice
    prompt "NXP soc choice"
    depends on NXP
    default IMX6ULL

    config IMX6ULL
        bool "i.MX 6UltraLite"
        select AARCH32
        select CORTEX_A7

    config IMX6Q
        bool "i.MX 6Quad"
        select AARCH32
        select CORTEX_A9
endchoice
endmenu

menu "Rockchip Platform Board"
config ROCKCHIP
    bool "Rockchip Electronics Co., Ltd."
    default n
    help
      Rockchip Electronics Co., Ltd

choice
    prompt "Rockchip soc choice"
    depends on ROCKCHIP
    default RV11XX

    config RV11XX
        bool "rv1126 or rv1109"
        select AARCH32

    config RK3399
        bool "rockchip 3399 chip"
        select AARCH64

    config RK3568
        bool "rockchip 3568 chip"
        select AARCH64

    config RK3588
        bool "rockchip 3588 chip"
        select AARCH64
endchoice
endmenu

menu "Nvidia Platform Board"
config NVIDIA
    bool "NVIDIA Corporation"
    default n
    help
      NVIDIA Corporation

choice
    prompt "Nvidia soc choice"
    depends on NVIDIA
    default JETSON

    config JETSON
        bool "jetson nano or nx"
        select AARCH64
endchoice

endmenu

endmenu
```
