## project/3rdparty/source/Kconfig
```kconfig
source "project/3rdparty/source/acl/Kconfig"
source "project/3rdparty/source/tbox/Kconfig"
source "project/3rdparty/source/zlib/Kconfig"
source "project/3rdparty/source/rtsp/Kconfig"
source "project/3rdparty/source/xlib/Kconfig"
source "project/3rdparty/source/media/Kconfig"
source "project/3rdparty/source/sqlite/Kconfig"
source "project/3rdparty/source/liblog/Kconfig"
source "project/3rdparty/source/libv4l/Kconfig"
source "project/3rdparty/source/libdrm/Kconfig"
source "project/3rdparty/source/live555/Kconfig"
source "project/3rdparty/source/rockchip/Kconfig"
source "project/3rdparty/source/mosquitto/Kconfig"
```

## project/3rdparty/source/acl/Kconfig
```kconfig
#
# ACL Kconfig
#

menu "One Advanced C/C++ Library"

config ACL
    tristate "Enable ACL"
    default n
    help
      The Acl (Advanced C/C++ Library) project a is powerful multi-platform network communication library and service framework, 
      suppoting LINUX, WIN32, Solaris, FreeBSD, MacOS, AndroidOS, iOS. Many applications written by Acl run on these devices with Linux, 
      Windows, iPhone and Android and serve billions of users. There are some important modules in Acl project, including network communcation, 
      server framework, application protocols, multiple coders, etc. 
      The common protocols such as HTTP/SMTP/ICMP//MQTT/Redis/Memcached/Beanstalk/Handler Socket are implemented in Acl, 
      and the codec library such as XML/JSON/MIME/BASE64/UUCODE/QPCODE/RFC2047/RFC1035, etc., are also included in Acl. 
      Acl also provides unified abstract interface for popular databases such as Mysql, Postgresql, Sqlite. 
      Using Acl library users can write database application more easily, quickly and safely.

endmenu
```

## project/3rdparty/source/liblog/Kconfig
```kconfig
#
# liblog Kconfig
#

menu "liblog Kconfig"

config LIBLOG
    tristate "Enable liblog"
    default n
    help
      liblog is a reliable, high-performance, thread safe, flexible, clear-model, pure C logging library.
      Actually, in the C world there was NO good logging library for applications like logback in java or
      log4cxx in c++. Using printf can work, but can not be redirected or reformatted easily.
      syslog is slow and is designed for system use. So I wrote liblog. It is faster, safer and more powerful than log4c.
      So it can be widely used.

config LIBLOG_COLOR
    tristate "Enable liblog color"
    depends on LIBLOG
    default n
    help
      liblog supports colored output.

endmenu
```

## project/3rdparty/source/mosquitto/Kconfig
```kconfig
#
# MQTT mosquitto Kconfig
#

menu "An open source MQTT - Eclipse Mosquitto"

config MOSQUITTO
    bool "Enable the MQTT tool mosquitto"
    default n
    help
      Enable the open source MQTT tool mosquitto

config MOSQUIITO_TLS
    bool "Mosquitto enable openssl"
    default n
    help
      mosquitto tool enables openssl

endmenu
```

## project/3rdparty/source/rtsp/Kconfig
```kconfig
#
# RTSP Kconfig
#

menu "RTSP Server and Client"

config RTSP
    bool "implementation rtsp"
    default n
    help
      Implementation rtsp

config RTSP_SERVER_CLIENT
    bool "rtsp server and client"
    default n
    depends on RTSP
    help
      Enable rtsp server and client.

config SIMPLE_RTSP_SERVER
    bool "simple rtsp server with c language"
    default n
    depends on RTSP
    help
      Enable simple rtsp server.

config RTSP_SERVER
    bool "rtsp server"
    default n
    depends on RTSP
    help
      Enable rtsp server.

endmenu
```

## project/3rdparty/source/sqlite/Kconfig
```kconfig
#
# sqlite3 Kconfig
#

menu "sqlite3"

config SQLITE3
    bool "sqlite3"
    default n
    help
      Enable sqlite3.

endmenu
```

## project/3rdparty/source/tbox/Kconfig
```kconfig
#
# CPP-TBOX Kconfig
#

menu "cpp-tbox"

config CPP_TBOX
    bool "service-oriented development framework"
    default n
    select MOSQUITTO
    help
      C++ Treasure Box is a service-oriented development framework and component library based on the Reactor model, aim at make C++ development easy.

endmenu
```

## project/3rdparty/source/xlib/Kconfig
```kconfig
#
# xlib Kconfig
#

menu "xlib"

config XLIB
    bool "xlib tools"
    default n
    help
      Enable xlib.

endmenu
```

## project/3rdparty/source/zlib/Kconfig
```kconfig
menu "zlib utils"

config ZLIB
    bool "zlib utils"
    default n
    help
      A massively spiffy yet delicately unobtrusive compression library.

endmenu
```

## project/Kconfig
```kconfig
#
# Project Kconfig
#

source "project/entry/Kconfig"
source "project/platform/Kconfig"

source "project/npu/Kconfig"
source "project/mpi/Kconfig"
source "project/3rdparty/Kconfig"
```

## project/mpi/Kconfig
```kconfig
#
# MPI Kconfig
#

menu "Media Process Interface"

config MPI
    bool "Media Process Interface"
    default n
    help
      Media Process Interface

source "project/mpi/rkmpi/Kconfig"
source "project/mpi/axmpi/Kconfig"

endmenu
```

## project/mpi/axmpi/Kconfig
```kconfig
#
# AXERA MPI Kconfig
#

menu "AXERA Media Process Interface"

config AXERA_MPI
    bool "axera platform media process interface"
    default n
    depends on AXERA
    select RTSP
    select SIMPLE_RTSP_SERVER
    help
      Axera platform media process interface

endmenu
```

## project/mpi/rkmpi/Kconfig
```kconfig
#
# Rockchip MPI Kconfig
#

menu "Rockchip Media Process Interface"

config ROCKCHIP_MPI
    bool "rockchip platform media process interface"
    default n
    depends on ROCKCHIP && MEDIA_API
    help
      Rockchip platform media process interface

config ROCKCHIP_PIPELINE
    bool "rockchip platform media process interface pipeline"
    default n
    depends on ROCKCHIP
    select MEDIA_API
    select RTSP
    select RTSP_SERVER
    help
      Rockchip platform media process interface pipeline

endmenu
```

## project/npu/Kconfig
```kconfig
#
#  NPU Kconfig
# 

menu "Algorithm NPU"

config NPU
    bool "Neural Processor Unit"
    default n
    help
      Enable Neural Processor Unit

source "project/npu/axnpu/Kconfig"
source "project/npu/rknpu/Kconfig"

endmenu
```

## project/npu/axnpu/Kconfig
```kconfig
#
# AXERA NPU Kconfig
# 

menu "AXERA NPU"

config AXNPU
    bool "Axera NPU"
    depends on AXERA
    default n
    help
      Axera NPU

endmenu
```

## project/npu/rknpu/Kconfig
```kconfig
#
# Rockchip NPU Kconfig
# 

menu "Rockchip NPU"

config RKNPU
    bool "Rockchip NPU"
    depends on ROCKCHIP
    default n
    help
      Rockchip NPU

choice

prompt "Rockchip NPU Architecture"
depends on RKNPU
default RKNPU1

config RKNPU1
    bool "Rockchip first generation NPU architecture"

config RKNPU2
    bool "Rockchip second generation NPU architecture"

endchoice

endmenu
```

## project/platform/Kconfig
```kconfig
#
# Project Kconfig
#

menu "Hardware platform"

choice
    prompt "ARM Cortex Architecture"
    default LINUX_GNU

    config CORTEX_A5
        bool "ARM Cortex A5"

    config CORTEX_A7
        bool "ARM Cortex A7"

    config CORTEX_A8
        bool "ARM Cortex A8"

    config CORTEX_A9
        bool "ARM Cortex A9"

    config CORTEX_A34
        bool "ARM Cortex A34"

    config CORTEX_A35
        bool "ARM Cortex A35"

    config CORTEX_A53
        bool "ARM Cortex A53"

    config CORTEX_A55
        bool "ARM Cortex A55"

    config CORTEX_A57
        bool "ARM Cortex A57"

    config CORTEX_A65
        bool "ARM Cortex A65"

    config CORTEX_A72
        bool "ARM Cortex A72"

    config CORTEX_A73
        bool "ARM Cortex A73"

    config CORTEX_A75
        bool "ARM Cortex A75"

    config CORTEX_A76
        bool "ARM Cortex A76"

    config CORTEX_A77
        bool "ARM Cortex A77"

    config CORTEX_A78
        bool "ARM Cortex A78"

    config LINUX_GNU
        bool "Linux GNU (eg. Ubuntu/Debian)"
endchoice

choice
    prompt "Hardware Architecture choice"
    default X86_64

    config AARCH32
        bool "aarch32 platform"

    config AARCH64
        bool "aarch64 platform"

    config X86_64
        bool "x86_64 platform"
endchoice

endmenu

source "project/platform/vendor/Kconfig"

if X86_64
source "project/platform/x86_64/Kconfig"
endif

if AARCH32
source "project/platform/aarch32/Kconfig"
endif

if AARCH64
source "project/platform/aarch64/Kconfig"
endif
```

## project/platform/aarch32/Kconfig
```kconfig
#
# aarch32 Kconfig
#

menu "AArch32 platform"

source "project/platform/aarch32/nxp/Kconfig"
source "project/platform/aarch32/axera/Kconfig"
source "project/platform/aarch32/rockchip/Kconfig"

endmenu
```

## project/platform/aarch32/axera/Kconfig
```kconfig
#
# AXera AArch32 Platform Application Kconfig
# 

menu "AXera AArch32 Platform Application"


endmenu

source "project/platform/aarch32/axera/ax620a/Kconfig"
source "project/platform/aarch32/axera/ax630a/Kconfig"
```

## project/platform/aarch32/axera/ax620a/Kconfig
```kconfig
#
# Axera AX620A Application Kconfig
# 

menu "AXERA AX620A Application"

choice
prompt "AXERA AX620A Application Implementation"
depends on AXERA && AX620A
default AX620A_EMS

config AX620A_EMS
    bool "Electronic rearview mirror system"
    select AXERA_MPI

config AX620A_EDGE_BOX
    bool "The AX620A computing box"
    select AXERA_MPI
    select RTSP
    select RTSP_SERVER
    select RTSP_SERVER_CLIENT

config AX620A_UNKNOWN
    bool "Unknown Application"
endchoice

endmenu
```
